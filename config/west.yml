## config/west.yml
```yaml
manifest:
  remotes:
    - name: sanzla
      url-base: https://github.com/sanzla
  projects:
    - name: zmk
      remote: sanzla
      revision: modifier-display
      import: app/west.yml
  self:
    path: config
```
